## conf/machine/olinuxino-a13som.conf
```bitbake
#@TYPE: Machine
#@NAME: Olimex A13-SOM
#@DESCRIPTION: Machine configuration for the Olimex A13-SOM Evaluation Board, based on Allwinner A13 CPU
#https://github.com/OLIMEX/SOM

require conf/machine/include/sun5i.inc

KERNEL_DEVICETREE = "sun5i-a13-olinuxino-micro.dtb"
UBOOT_MACHINE = "A13-OLinuXinoM_defconfig"
SUNXI_FEX_FILE = "sys_config/a13/a13-olinuxinom.fex"
```
